## arch/Kconfig
```kconfig
config ARCH_RISCV
	bool "RISC-V architecture"
	help
	  Say 'y' to select RISC-V architecture

config SYS_ARCH
	string
	help
	  This option should contain the architecture name to build
	  the appropriate arch/<CONFIG_SYS_ARCH> directory.
	  All the architectures should specify this option correctly.

source "arch/riscv/Kconfig"
```

## arch/riscv/Kconfig
```kconfig
if ARCH_RISCV

config SYS_ARCH
	default "riscv"

config CPU_IBEX
	bool "Ibex RV32IM core"
	help
	  Say 'y' to select Ibex RISC-V core

config COUNTER_FREQUENCY
	int "Timer clock frequency"
	default 0
	help
	  Setup time clock frequency for certain platform.
	  0 means no need to configure the system counter frequency.

endif
```

## configs/ast2700-rom_defconfig
```kconfig
CONFIG_CROSS_COMPILE="riscv32-unknown-elf-"
CONFIG_BINARY_NAME="ast2700_rom"
CONFIG_SYS_TEXT_BASE=0x14b00000
CONFIG_SYS_MAX_SIZE=0x12000
CONFIG_SYS_INIT_STACK_ADDR=0x14bbe000
CONFIG_SYS_MALLOC_LEN=0x4000
CONFIG_SYS_CONSOLE_BASE=0x14c33b00
CONFIG_DEBUG=y
CONFIG_COUNTER_FREQUENCY=200000000
CONFIG_BSS_DATA_ADDR=0x14bbe000
CONFIG_BSS_DATA_SIZE=0x1800
CONFIG_ROM_MAJOR_VER=0x01
CONFIG_ROM_MINOR_VER=0x03
CONFIG_FMC_LOAD_ADDR=0x14b80000
CONFIG_FMC_LOAD_SIZE=0x38000
CONFIG_FMC_ENTRY_ADDR=0x14b80a00
CONFIG_CPTRA_LOAD_ADDR=0x14b80000
CONFIG_CPTRA_LOAD_SIZE=0x20000
CONFIG_CPTRA_EXEC_TMOUT=100000
CONFIG_UART=y
CONFIG_OTP=y
CONFIG_SLI=y
CONFIG_SPI=y
CONFIG_LTPI=y
CONFIG_MMC=y
CONFIG_USB=y
CONFIG_WDT=y
CONFIG_UFS=y
CONFIG_CALIPTRA=y
CONFIG_TRNG=y
CONFIG_SEC=y
CONFIG_SPI_FMC=y
CONFIG_I3C=y
CONFIG_I2C=y
CONFIG_AHBC=y
```

## drivers/Kconfig
```kconfig
menu "Drivers"

config UART
	bool "UART (NS16550A)"
	help
	  Say 'y' to enable NS16550A-compatible UART

config OTP
	bool "OTP"
	help
	  Say 'y' to enable Aspeed OTP

config SLI
	bool "SLI"
	help
	  Say 'y' to enable the SLI driver

config SPI
	bool "SPI"
	help
	  Say 'y' to enable SPI support

config LTPI
	bool "LTPI"
	help
	  Say 'y' to enable LTPI driver

config MMC
	bool "MMC"
	help
	  Say 'y' to enable MMC support

config USB
	bool "USB"
	help
	  Say 'y' to enable USB support

config WDT
	bool "WDT"
	help
	  Say 'y' to enable WDT support

config UFS
	bool "UFS"
	help
	  Say 'y' to enable UFS support

config CALIPTRA
	bool "Caliptra"
	help
	  Say 'y' to enable Caliptra support

config TRNG
	bool "TRNG"
	help
	  Say 'y' to enable TRNG support

config SEC
	bool "SEC"
	help
	  Say 'y' to enable SEC support

config I3C
	bool "I3C"
	help
	  Say 'y' to enable I3C support

config I2C
	bool "I2C"
	help
	  Say 'y' to enable I2C support

config AHBC
	bool "AHBC"
	help
	  Say 'y' to enable AHBC support

config TIMER
	bool "Timer"
	help
	  Say 'y' to enable timer support

source "drivers/caliptra/Kconfig"
source "drivers/uart/Kconfig"
source "drivers/spi/Kconfig"
source "drivers/sli/Kconfig"
source "drivers/timer/Kconfig"

endmenu
```

## drivers/dram/Kconfig
```kconfig
if DRAM

config DDR_PHY_TRAINING
	bool "Enable DDR phy training"
	help
	  Say 'y' to enable the PHY training

choice
	prompt "Select DDR4/DDR5"
	default DDR4_TYPE

config DDR4_TYPE
	bool "DDR4 type"
	help
	  select DDR4 memory type

config DDR5_TYPE
	bool "DDR5 type"
	help
	  select DDR5 memory type

endchoice

if DDR4_TYPE
choice
	prompt "DDR4 target data rate"
	default ASPEED_DDR4_1600

config DDR4_1600
	bool "DDR4 targets at 1600Mbps"
	help
	  select DDR4 target data rate at 1600M

config DDR4_2400
	bool "DDR4 targets at 2400Mbps"
	help
	  select DDR4 target data rate at 2400M

config DDR4_3200
	bool "DDR4 targets at 3200Mbps"
	help
	  select DDR4 target data rate at 3200M
endchoice

choice
	prompt "DDR4 size"
	default DDR4_4G

config DDR4_4G
	bool "DDR4 4G"
	help
	  select DDR4 4G

config DDR4_16G
	bool "DDR4 16G"
	help
	  select DDR4 16G
endchoice

endif

endif
```

## drivers/spi/Kconfig
```kconfig
if SPI

config CA35_SPI_FLASH_SRC_ADDR
	hex "Cortex-A35 BL0 image SPI source address"
	depends on PROJ_AST2700_RAM
	default 0x20060000
	help
	  The SPI memory address where CA35 BL0 image will be loaded from.

config SPI_FMC
	bool "SPI_FMC"
	default n
	help
	  Say 'y' to enable SPI FMC support

endif
```

## drivers/timer/Kconfig
```kconfig
if TIMER

config RV_TIMER
	bool "RISC-V compatible timer"
	help
	  Say 'y' to enable timer support for RISC-V cores.

endif
```

## proj/Kconfig
```kconfig
config PLAT_AST2700
	bool "AST2700 platform"
	help
	  Say 'y' to select AST2700 platform

choice
	prompt "Project select"

config PROJ_AST2700_ROM
	bool "AST2700 ROM"
	select ARCH_RISCV
	select CPU_IBEX
	select PLAT_AST2700
	help
	  Say 'y' to build AST2700 ROM code

endchoice

config SYS_PROJ
	string
	help
	  This option should contain the project name to build
	  the appropriate proj/<CONFIG_SYS_PROJ> directory.
	  All the projects should specify this option correctly.

source "proj/ast2700_rom/Kconfig"
```

## proj/ast2700_rom/Kconfig
```kconfig
if PROJ_AST2700_ROM

config SYS_PROJ
	default "ast2700_rom"

config BSS_DATA_ADDR
	hex "Reserved address for BSS and DATA section"
	help
	  Reserved memory address for ROM to read/write
	  .bss and .data variables.

config BSS_DATA_SIZE
	hex "Reserved size in bytes for BSS and DATA section"
	help
	  Reserve memory size in bytes for ROM to read/write
	  .bss and .data variables.

config ROM_MAJOR_VER
	hex "ROM major version number"
	help
	  the ROM major version (0x00~0xff) shown in the banner message.

config ROM_MINOR_VER
	hex "ROM minor version number"
	help
	  the ROM minor version (0x00~0xff) shown in the banner message.

config FMC_LOAD_ADDR
	hex "FMC load address"
	help
	  The address where the First Mutable Code (FMC) will be loaded to.

config FMC_LOAD_SIZE
	hex "FMC maximum load size in bytes"
	help
	  The maximum bytes to load the First Mutable Code (FMC)

config FMC_ENTRY_ADDR
	hex "FMC entry address"
	help
	  The entry point of First Mutable Code (FMC) entry point.

config CPTRA_LOAD_ADDR
	hex "Caliptra FW load address"
	help
	  The address where the Caliptra FW will be loaded to.

config CPTRA_LOAD_SIZE
	hex "Caliptra FW maximum load size in bytes"
	help
	  The maximum bytes to load the Caliptra FW

config CPTRA_EXEC_TMOUT
	int "Calitpra execution timeout in us"
	help
	  The timeout in microsecond (us) for Caliptra execution

endif
```

## src/Kconfig
```kconfig
mainmenu "Aspeed BootMCU Configuration"

menu "General setup"

config CROSS_COMPILE
	string "Cross-compiler tool prefix"
	help
	  Same as running 'make CROSS_COMPILE=prefix-' but stored for
	  default make runs in this application build directory.  You don't
	  need to set this unless you want the configured application build
	  directory to select the cross-compiler automatically.

choice
	prompt "Compiler optimization level"
	default CC_OPTIMIZE_NONE

config CC_OPTIMIZE_NONE
	bool "Without Optimize"

config CC_OPTIMIZE_FOR_PERFORMANCE
	bool "Optimize for performance (-O2)"
	help
	  This is the default optimization level for the kernel, building
	  with the "-O2" compiler flag for best performance and most
	  helpful compile-time warnings.

config CC_OPTIMIZE_FOR_SIZE
	bool "Optimize for size (-Os)"
	help
	  Enabling this option will pass "-Os" instead of "-O2" to
	  your compiler resulting in a smaller kernel.
	  If unsure, say N.
endchoice

config BINARY_NAME
	default "soc"
	string "Binary name"
	help
	  This is binary name definition.

config SYS_TEXT_BASE
	hex "Text base"
	help
	  The address that SOC will be running from.

config SYS_MAX_SIZE
	hex "Maximum image size"
	help
	  The maximum size of the generated image.

config SYS_INIT_STACK_ADDR
	hex "Initial stack address"
	help
	  The address that stack will be growing from.

config SYS_MALLOC_LEN
	hex "Maximum malloc size"
	help
	  the heap space reserved on top of stack for malloc() use

config SYS_CONSOLE_BASE
	hex "Console UART base"
	help
	  The ns16550a-compatible UART base

config DEBUG
	bool "Debug"
	help
	  Say 'y' to enable debug messages

endmenu

source "arch/Kconfig"
source "proj/Kconfig"
source "drivers/Kconfig"
```

## src/proj/ast2700_rom/Kconfig
```kconfig
if PROJ_AST2700_ROM

config SYS_PROJ
	default "ast2700_rom"

config BSS_DATA_ADDR
	hex "Reserved address for BSS and DATA section"
	help
	  Reserved memory address for ROM to read/write
	  .bss and .data variables.

config BSS_DATA_SIZE
	hex "Reserved size in bytes for BSS and DATA section"
	help
	  Reserve memory size in bytes for ROM to read/write
	  .bss and .data variables.

config RAM_CODE_LOAD_ADDR
	hex "RAM code load address"
	help
	  The address where the RAM code will be loaded to.

config RAM_CODE_LOAD_SIZE
	hex "RAM code load size in bytes"
	help
	  The total bytes to load the RAM code.

config RAM_CODE_ENTRY_ADDR
	hex "RAM code entry address"
	help
	  The address of RAM code entry point.

endif
```
